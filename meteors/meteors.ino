// OLED Meteor Defenders using Adafruit GFX Library
#include <SPI.h>
#include <Wire.h>
#include <Adafruit_GFX.h>
#include <Adafruit_SSD1306.h>

#define WIDTH 128
#define HEIGHT 64

#define OLED_MOSI  23 // SCL
#define OLED_CLK   18 // SDA
#define OLED_DC    21
#define OLED_CS    5
#define OLED_RESET 4

Adafruit_SSD1306 display(WIDTH, HEIGHT,
  OLED_MOSI, OLED_CLK, OLED_DC, OLED_RESET, OLED_CS);


#define NUMFLAKES 10
#define XPOS 0
#define YPOS 1
#define DELTAY 2

// '8518557ff29ae43b906854a2928baafdd0e004e2f4543a5c794591c1e8d45c17', 128x64px
const unsigned char planet [] PROGMEM = {
  0x00, 0x00, 0x00, 0x00, 0x00, 0x00, 0x00, 0x00, 0x00, 0x00, 0x00, 0x00, 0x00, 0x00, 0x00, 0x00, 
  0x00, 0x00, 0x00, 0x00, 0x00, 0x00, 0x00, 0x00, 0x00, 0x00, 0x00, 0x00, 0x00, 0x00, 0x00, 0x00, 
  0x00, 0x00, 0x00, 0x00, 0x00, 0x00, 0x00, 0x00, 0x00, 0x00, 0x00, 0x00, 0x00, 0x00, 0x00, 0x00, 
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  0x00, 0x00, 0x00, 0x00, 0x00, 0x00, 0x00, 0x00, 0x00, 0x00, 0x00, 0x00, 0x00, 0x00, 0x00, 0x00
};

// 'laser_gun', 9x7px
const unsigned char laser_gun [] PROGMEM = {
  0xe0, 0x00, 0xc0, 0x00, 0x67, 0x80, 0x7f, 0x80, 0x67, 0x80, 0xc0, 0x00, 0xe0, 0x00
};


static const unsigned char PROGMEM logo16_glcd_bmp[] =
{ B00000000, B11000000,
  B00000001, B11000000,
  B00000001, B11000000,
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  B00000000, B00110000
};

//#if (SSD1306_LCDHEIGHT != 64)
//#error("Height incorrect, please fix Adafruit_SSD1306.h!");
//#endif

#define BUTUP 19
#define BUTDOWN 16
#define BUTLEFT 22
#define BUTRIGHT 17

// Dont forget to change the values in the redefinition section too!

boolean quit = false;
int stepUD = 0;

int x1 = 8;
int y11 = 6;

int bulx = 0;
int buly = 0;
boolean bullet = false;

int meteox = 0;
int meteoy = 0;
boolean meteor = false;

int meteox2 = 0;
int meteoy2 = 0;
boolean meteor2 = false;

int meteorsize = 4;

int meteorspeed = 1;
int bulletspeed = 6;

int luck = 0;
int trispeed = 3;
unsigned int score = 0;
unsigned int highscore = 0;

int randx1 = 100;
int randx2 = 127;
int randy1 = 6;
int randy2 = 58;

void setup()   {
  Serial.begin(9600);

  pinMode(BUTUP, INPUT_PULLUP);
  pinMode(BUTDOWN, INPUT_PULLUP);
  pinMode(BUTRIGHT, INPUT_PULLUP);
  pinMode(BUTLEFT, INPUT_PULLUP);

  // by default, we'll generate the high voltage from the 3.3v line internally! (neat!)
  display.begin(SSD1306_SWITCHCAPVCC, 0x3C);  // initialize with the I2C addr 0x3D (for the 128x64)
  // init done

  // Show image buffer on the display hardware.
  // Since the buffer is intialized with an Adafruit splashscreen
  // internally, this will display the splashscreen.
  display.clearDisplay();
  display.drawBitmap(0, 0, planet, WIDTH, HEIGHT, 1); 
  display.setTextSize(1);
  display.setTextColor(WHITE);
  display.setCursor(20, 0);
  display.println("METEOR DEFENDERS");
  display.display();
  delay(6000);
}

void loop()  {
  
  // Redefinition section
  quit = false;
  stepUD = 0;

  x1 = 8;
  y11 = 6;

  bulx = 0;
  buly = 0;
  bullet = false;

  meteox = 0;
  meteoy = 0;
  meteor = false;

  meteox2 = 0;
  meteoy2 = 0;
  meteor2 = false;

  meteorsize = 4;

  bulletspeed = 4;
  meteorspeed = 1;

  luck = random(40, 100);
  trispeed = 3;
  // don't reset the score
  // don't reset the highscore

  randx1 = 100;
  randx2 = 127;
  randy1 = 6;
  randy2 = 58;

  //intro------------------------------------------------------------------------------
  
  display.clearDisplay();

  while (digitalRead(BUTUP) == ! LOW) {
    // title
    display.setCursor(0, 0);
    // High score
    if (score > highscore) {
      highscore = score;
    }
    display.println("High score:");
    display.setCursor(20, 8);
    display.print(highscore);
    
    display.display();
    // turns the text on and off
    delay(200);
    display.setCursor(64 - (128 / 2), 20);
    display.println("Press UP button long to continue");
    display.display();
    delay(200);
    display.clearDisplay();
  }

 score  = 0;

// Part two --------------------The Game--------------

  while (quit == false) {

    //check if the triangle is bad
    
    if (y11 < -3) {
      y11 = 56;
    }
    
    if (y11 >= 60) {
      y11 = 0;
    }

    //check inputs
    if (digitalRead(BUTDOWN) == LOW) {
      stepUD = trispeed;
    }

    if (digitalRead(BUTUP) == LOW) {
      stepUD = -trispeed;
    }

    if (digitalRead(BUTLEFT) == LOW) {
      bullet = true;
    }

    //bullet maker
    if (bullet == true) {
      if (bulx < 127) {
        display.drawPixel(bulx, buly, WHITE);
        bulx = bulx + bulletspeed;
      }
      else {
        bullet = false;
      }
    }
    else {
      bulx = x1 + 9;
      buly = y11 + 4;
    }

    //meteor maker
    if (luck < 0) {

      meteor = true;
      if (score > 1000) {
        meteor2 = true;
      }
      if (score > 1500) {
        meteorspeed = 2;
      }
    }

    //meteor 1
    if (meteor == true) {


      if (meteox > 0) {
        drawPolygon(meteox, meteoy, 6, meteorsize, meteox, WHITE);
        meteox = meteox - meteorspeed;
      }
      else {
        meteor = false;
        quit = true;
      }
      
      if ((bullet == true) && (bulx <= meteox + meteorsize) && (bulx >= meteox - meteorsize) && (buly <= meteoy + meteorsize) && (buly >= meteoy - meteorsize)) {
         meteor = false;
         bullet = false;
         luck = random(25, 125);
         display.drawLine(bulx - 6, buly - 6, bulx + 6, buly + 6, WHITE);
         display.drawLine(bulx - 6, buly + 6, bulx + 6, buly - 6, WHITE);
      }
      
    }
    else {

      meteox = random(randx1, randx2);
      meteoy = random(randy1, randy2);
    }

    // meteor 2
    if (meteor2 == true) {


      if (meteox2 > 0) {
        drawPolygon(meteox2, meteoy2, 6, meteorsize, meteox, WHITE);
        meteox2 = meteox2 - meteorspeed;
      }
      else {
        meteor2 = false;
        quit = true;
      }

      if ((bullet == true) && (bulx <= meteox2 + meteorsize) && (bulx >= meteox2 - meteorsize) && (buly <= meteoy2 + meteorsize) && (buly >= meteoy2 - meteorsize)) {
         meteor2 = false;
         bullet = false;
         luck = random(25, 125);
         display.drawLine(bulx - 6, buly - 6, bulx + 6, buly + 6, WHITE);
         display.drawLine(bulx - 6, buly + 6, bulx + 6, buly - 6, WHITE);
    }
    
    }
    else {
      meteox2 = random(randx1, randx2);
      meteoy2 = random(randy1, randy2);
    }
    

    //standard stuff (Starring: Circle as the big plannet, Triangle as the space ship)
    display.fillCircle(-58, 32, 64, WHITE);
    display.setCursor(0, 0);
    display.print(score);
   
    //turrent position variable
    y11 = y11 + stepUD;
   
    display.drawBitmap(x1, y11, laser_gun, 9, 7, 1);
    display.display();


    //counters
    stepUD = 0;
    if (luck > 0) {
      luck = luck - 5;
    }
    else {
      luck = -1;
    }
    score = score + 1;

    delay(50);
    display.clearDisplay();
  }
}

void drawPolygon(int16_t cx, int16_t cy, uint8_t sides, int16_t diameter, float rot, uint16_t color)
{ 
  sides = (sides > 2? sides : 3);
  float dtr = (PI/180.0) + PI;
  float rads = 360.0 / sides;//points spacd equally
  uint8_t i;
  for (i = 0; i < sides; i++) { 
    display.drawLine(
      cx + (sin((i*rads + rot) * dtr) * diameter),
      cy + (cos((i*rads + rot) * dtr) * diameter),
      cx + (sin(((i+1)*rads + rot) * dtr) * diameter),
      cy + (cos(((i+1)*rads + rot) * dtr) * diameter),
      color);
  }
}
